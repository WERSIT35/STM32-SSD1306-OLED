#include "ssd1306.h"

// Small 5x7 font (ASCII 32–127)
static const uint8_t Font5x7[][5] = {
    {0x00,0x00,0x00,0x00,0x00}, // ' '
    {0x00,0x00,0x5F,0x00,0x00}, // !
    {0x00,0x07,0x00,0x07,0x00}, // "
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    {0x44,0x64,0x54,0x4C,0x44}  // z
};

// Global helper
static void SSD1306_SendCommand(uint8_t cmd) {
    uint8_t d[2] = {0x00, cmd};
    HAL_I2C_Master_Transmit(&hi2c1, SSD1306_I2C_ADDR, d, 2, HAL_MAX_DELAY);
}

static void SSD1306_SendData(uint8_t *data, uint16_t size) {
    uint8_t buffer[129];
    buffer[0] = 0x40; 
    memcpy(&buffer[1], data, size);
    HAL_I2C_Master_Transmit(&hi2c1, SSD1306_I2C_ADDR, buffer, size + 1, HAL_MAX_DELAY);
}

// Init SSD1306
void SSD1306_Init(void) {
    for (volatile int i=0;i<100000;i++);

    SSD1306_SendCommand(0xAE);
    SSD1306_SendCommand(0xD5);
    SSD1306_SendCommand(0x80);
    SSD1306_SendCommand(0xA8);
    SSD1306_SendCommand(0x3F);
    SSD1306_SendCommand(0xD3);
    SSD1306_SendCommand(0x00);
    SSD1306_SendCommand(0x40);
    SSD1306_SendCommand(0x8D);
    SSD1306_SendCommand(0x14);
    SSD1306_SendCommand(0x20);
    SSD1306_SendCommand(0x00);
    SSD1306_SendCommand(0xA1);
    SSD1306_SendCommand(0xC8);
    SSD1306_SendCommand(0xDA);
    SSD1306_SendCommand(0x12);
    SSD1306_SendCommand(0x81);
    SSD1306_SendCommand(0x7F);
    SSD1306_SendCommand(0xD9);
    SSD1306_SendCommand(0xF1);
    SSD1306_SendCommand(0xDB);
    SSD1306_SendCommand(0x40);
    SSD1306_SendCommand(0xA4);
    SSD1306_SendCommand(0xA6);
    SSD1306_SendCommand(0xAF);
}

void SSD1306_Clear(void) {
    uint8_t zero[128];
    memset(zero, 0x00, sizeof(zero));
    for (uint8_t page = 0; page < 8; page++) {
        SSD1306_SendCommand(0xB0 + page);
        SSD1306_SendCommand(0x00);
        SSD1306_SendCommand(0x10);
        SSD1306_SendData(zero, 128);
    }
}

void SSD1306_AllOn(void) {
    uint8_t full[128];
    memset(full, 0xFF, sizeof(full));
    for (uint8_t page = 0; page < 8; page++) {
        SSD1306_SendCommand(0xB0 + page);
        SSD1306_SendCommand(0x00);
        SSD1306_SendCommand(0x10);
        SSD1306_SendData(full, 128);
    }
}

void SSD1306_SetCursor(uint8_t x, uint8_t y) {
    SSD1306_SendCommand(0xB0 + y);
    SSD1306_SendCommand(0x00 + (x & 0x0F));
    SSD1306_SendCommand(0x10 + ((x >> 4) & 0x0F));
}

// Write one character
void SSD1306_WriteChar(char c) {
    if (c < 32 || c > 126) c = '?';
    const uint8_t *bitmap = Font5x7[c - 32];
    SSD1306_SendData((uint8_t *)bitmap, 5);
    uint8_t space = 0x00;
    SSD1306_SendData(&space, 1);
}

// Write string
void SSD1306_WriteString(char *str) {
    while (*str) {
        SSD1306_WriteChar(*str++);
    }
}

void SSD1306_DisplayOn(void) { SSD1306_SendCommand(0xAF); }
void SSD1306_DisplayOff(void){ SSD1306_SendCommand(0xAE); }
